#include "audio.dtsi" 
#include "display.dtsi"
#include "touchscreen.dtsi"
#include "../common/power-qrd.dtsi"
#include "../common/misc-qrd.dtsi" 
#include "../common/battery-qrd.dtsi"
#include "../common/regulator-qrd.dtsi"