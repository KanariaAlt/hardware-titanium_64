/* msm8953-qrd */
&led_flash0{
	 qcom,flash-source = <&pmi8950_flash0 &pmi8950_flash1>;
	 qcom,torch-source = <&pmi8950_torch0 &pmi8950_torch1>;
};

&usb3 {
	qcom,usbin-vadc = <&pmi8950_vadc>;
	qcom,detect-dpdm-floating;
	vbus_dwc3-supply = <&smbcharger_charger_otg>;
};
