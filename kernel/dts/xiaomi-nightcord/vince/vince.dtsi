#include "pinctrl.dtsi"
#include "android.dtsi"
#include "audio.dtsi" 
#include "vince-qrd.dtsi" 
#include "display.dtsi" 
#include "fingerprint.dtsi" 
#include "touchscreen.dtsi" 
#include "camera.dtsi"
#include "../common/power-qrd.dtsi"
#include "power.dtsi"
#include "../common/misc-qrd.dtsi"
#include "../common/battery-qrd.dtsi"
#include "../common/regulator-qrd.dtsi"